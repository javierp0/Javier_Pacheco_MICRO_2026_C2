## Tarea 3/main/Kconfig.projbuild
```kconfig
menu "Tarea 3 - ESP32 WiFi MQTT"

    config TAREA3_WIFI_SSID
        string "Nombre de la red WiFi"
        default "CAMBIA_TU_WIFI"
        help
            SSID de la red WiFi donde se conectara el ESP32.

    config TAREA3_WIFI_PASSWORD
        string "Clave de la red WiFi"
        default "CAMBIA_TU_CLAVE"
        help
            Clave de la red WiFi. Dejar vacio solo si la red es abierta.

    config TAREA3_MQTT_URI
        string "URI del broker MQTT"
        default "mqtt://broker.hivemq.com:1883"
        help
            Broker MQTT usado por el ESP32. Ejemplo: mqtt://broker.hivemq.com:1883

    config TAREA3_TOPIC_BASE
        string "Topic base MQTT"
        default "javier_pacheco_micro_2026_c2/tarea3"
        help
            Topic base usado para comandos y estado.

    config TAREA3_LED_GPIO
        int "GPIO del LED"
        default 2
        range 0 39
        help
            En muchas placas ESP32 DevKit el LED integrado esta en GPIO2.

    config TAREA3_BUTTON_GPIO
        int "GPIO del boton"
        default 0
        range 0 39
        help
            En muchas placas ESP32 DevKit el boton BOOT esta en GPIO0.

endmenu
```

## Tarea 3/sdkconfig.defaults
```kconfig
CONFIG_IDF_TARGET="esp32"
CONFIG_IDF_TARGET_ESP32=y
CONFIG_ESPTOOLPY_FLASHSIZE_4MB=y
CONFIG_ESPTOOLPY_FLASHSIZE="4MB"

CONFIG_TAREA3_WIFI_SSID="CAMBIA_TU_WIFI"
CONFIG_TAREA3_WIFI_PASSWORD="CAMBIA_TU_CLAVE"
CONFIG_TAREA3_MQTT_URI="mqtt://broker.hivemq.com:1883"
CONFIG_TAREA3_TOPIC_BASE="javier_pacheco_micro_2026_c2/tarea3"
CONFIG_TAREA3_LED_GPIO=2
CONFIG_TAREA3_BUTTON_GPIO=0
```

## Tarea 7/main/Kconfig.projbuild
```kconfig
menu "Tarea 7 - Medidor de reaccion humana"

    config REACTION_WIFI_SSID
        string "WiFi SSID"
        default ""
        help
            Nombre de la red WiFi usada por el ESP32 clasico.

    config REACTION_WIFI_PASSWORD
        string "WiFi password"
        default ""
        help
            Contrasena de la red WiFi. Dejar vacio solo para redes abiertas.

    config REACTION_MQTT_URI
        string "MQTT broker URI"
        default "mqtt://broker.hivemq.com:1883"
        help
            Broker usado para publicar los datos del ensayo.

    config REACTION_MQTT_USERNAME
        string "MQTT username"
        default ""
        help
            Usuario MQTT. Por defecto queda vacio para HiveMQ public broker.

    config REACTION_MQTT_PASSWORD
        string "MQTT password"
        default ""
        help
            Contrasena MQTT. Por defecto queda vacia para HiveMQ public broker.

    config REACTION_TOPIC_BASE
        string "MQTT topic base"
        default "Javier Pacheco/tarea8/reaccion"
        help
            Topico base solicitado para visualizar en MQTTX.

endmenu
```
